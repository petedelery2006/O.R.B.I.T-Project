/* ORBIT Mega 2560 — SOFTWARE I2C: SDA=A4, SCL=A5.
   Move shared SDA from D20 to A4 and shared SCL from D21 to A5.
   Required libraries: U8g2, SoftwareWire (Testato), Adafruit BMP280 Library
   (install its Adafruit BusIO and Adafruit Unified Sensor dependencies).
   BMP280 ONLY: hardware I2C SDA=D20, SCL=D21; auto-detect 0x77 / 0x76.
   Keep the OLEDs and all existing software-I2C devices on A4/A5.
   D23 open: LCD temperature / humidity. Closed to GND: altitude / pressure.
   Altitude is estimated in feet using SEA_LEVEL_HPA below; pressure is hPa.
   Set SEA_LEVEL_HPA to local sea-level pressure (QNH) for calibrated altitude.
   BMP280 is local to the Mega; existing Uno UART protocol stays compatible.
   LCD=0x27, small OLED=0x3C, large OLED=0x3D, AHT30=0x38, INA219=0x40.
   INA219: assumes battery-side measurement and standard R100 shunt.
   One Fitinoch 12V 5Ah LiFePO4 battery; second pack is a spare.
   Percentage is a rough voltage estimate, NOT a calibrated fuel gauge.
   Usage totals reset at startup.
   RGB common cathode by default. EEPROM bytes 0..7 and 16..19 reserved.
   Sound settings: independent startup and air-sample tune, global mute.
   Home: strongest RAW AS7341 band; location/day-night are uncertain guesses.
   Debugging: tap D24 through information pages; hold Go back to return.
   Controls: D6 -> GND starts air sampling (dedicated button).
   D24 -> GND controls OLED: hold 2 seconds opens/selects; tap advances.
   D23 -> GND LCD switch; debounced state sent on UART1 AND UART3, 9600 baud.
   Serial1: TX=D18 -> Uno D10; RX=D19 <- Uno D11.
   Serial3: TX=D14 -> Uno D10; RX=D15 <- Uno D11. Common GND.
   Receiver sketches must parse SW=0/1 and SAMPLE=0/1 lines (see protocol).
   Fan animation lasts 6 seconds; physical fans retain their 30-second cycle.
   Battery time is a rough estimate from voltage, nominal capacity and load.
   Requires INA219 to measure ALL battery loads; not reliable while charging.
   Frame assets are adapted from the approved saved air-sample preview.
*/
#include <Arduino.h>
#include <string.h>
#include <stdlib.h>
#include <errno.h>
#include <SoftwareWire.h>
#include <Wire.h>
#include <Adafruit_BMP280.h>
#include <U8g2lib.h>
#include <EEPROM.h>
#include <avr/pgmspace.h>
#include <math.h>

const byte FAN1=49, FAN2=47, POWER_LED=43, RGB_G=41, RGB_B=39;
const byte FAN_BUTTON=6, BUZZER=38;
const bool RGB_COMMON_ANODE=false;
const unsigned long FAN_MS=30000UL, FLASH_MS=125UL;
const byte SDA_PIN=A4, SCL_PIN=A5;
SoftwareWire bus(SDA_PIN,SCL_PIN);
Adafruit_BMP280 bmp(&Wire);
const float SEA_LEVEL_HPA=1013.25f; // Standard reference, NOT current local QNH.
bool bmpOK=false, bmpValid=false, bmpSeen=false, bmpTimeoutSeen=false;
byte bmpAddress=0;
float pressureHPA=0, altitudeFT=0, bmpTempF=0;
unsigned long lastBMP=0, lastBMPGood=0, lastBMPAttempt=0;
uint16_t bmpErrors=0;
U8G2_SSD1306_128X64_NONAME_F_SW_I2C smallOLED(U8G2_R0,SCL_PIN,SDA_PIN,U8X8_PIN_NONE);
U8G2_SSD1309_128X64_NONAME2_F_SW_I2C largeOLED(U8G2_R0,SCL_PIN,SDA_PIN,U8X8_PIN_NONE);
bool lcdOK, smallOK, largeOK, ahtOK, inaOK;
bool climateValid=false, powerValid=false, powerOverflow=false;
bool climatePending=false;
float filteredBatteryV=0;
bool batteryEstimateReady=false;
float tempF=0, humidity=0, batteryV=0, currentMA=0, watts=0;
float usedMAh=0, usedWh=0;
bool fans=false;
unsigned long fanStarted=0, lastClimate=0, lastPower=0, lastDisplay=0;
unsigned long lastIntegration=0;
bool previousPowerValid=false;
float previousMA=0, previousW=0;

// Original first twelve audition tunes. Pairs: frequency Hz, duration ms.
const uint16_t t1[] PROGMEM={523,150,0,35,659,150,0,35,784,220,0,55,1047,450};
const uint16_t t2[] PROGMEM={784,110,0,90,784,110,0,180,1047,160,0,40,1319,330};
const uint16_t t3[] PROGMEM={523,90,587,90,659,90,784,90,880,90,1047,90,0,70,1568,300};
const uint16_t t4[] PROGMEM={659,260,0,100,988,260,0,100,784,260,0,100,740,200,659,500};
const uint16_t t5[] PROGMEM={523,70,784,70,1047,70,1319,70,1568,130,0,70,1319,100,1568,300};
const uint16_t t6[] PROGMEM={659,170,0,85,784,170,0,85,1047,280};
const uint16_t t7[] PROGMEM={523,110,0,190,523,110,0,190,784,110,0,120,1047,160,1319,160,1568,360};
const uint16_t t8[] PROGMEM={587,140,0,45,880,200,0,45,784,110,659,110,0,60,1175,400};
const uint16_t t9[] PROGMEM={1047,70,0,200,1319,70,0,200,1568,70,0,350,1047,70,0,200,1319,70,0,200,1568,70,0,350};
const uint16_t t10[] PROGMEM={523,65,587,65,659,65,784,65,880,65,784,65,659,65,587,65,0,250,523,65,587,65,659,65,784,65,880,65,784,65,659,65,587,65};
const uint16_t t11[] PROGMEM={880,65,0,95,880,65,0,310,1319,65,0,95,1319,65,0,310,880,65,0,95,1319,130};
const uint16_t t12[] PROGMEM={784,100,0,70,1047,160};
const uint16_t* const tunes[]={t1,t2,t3,t4,t5,t6,t7,t8,t9,t10,t11,t12};
#define WORDS(x) (sizeof(x)/sizeof(x[0]))
const uint16_t lengths[]={WORDS(t1),WORDS(t2),WORDS(t3),WORDS(t4),WORDS(t5),WORDS(t6),WORDS(t7),WORDS(t8),WORDS(t9),WORDS(t10),WORDS(t11),WORDS(t12)};
const uint16_t* sound=NULL;
uint16_t soundWords=0, soundPos=0;
unsigned long noteStarted=0, noteDuration=0;
bool soundRepeat=false;

// Startup logo: five 5x7 letters rise as separated pixels, then assemble.
const byte logoRows[5][7] PROGMEM={
  {14,17,17,17,17,17,14}, // O
  {30,17,17,30,20,18,17}, // R
  {30,17,17,30,17,17,30}, // B
  {31,4,4,4,4,4,31},     // I
  {31,4,4,4,4,4,4}      // T
};
const unsigned long LETTER_RISE_MS=650UL;
const unsigned long LOGO_ASSEMBLE_MS=900UL;
const unsigned long LOGO_HOLD_MS=800UL;
const unsigned long LOGO_RISE_END=5UL*LETTER_RISE_MS;
const unsigned long LOGO_TOTAL_MS=LOGO_RISE_END+LOGO_ASSEMBLE_MS+LOGO_HOLD_MS;
bool startupAnimating=true;
unsigned long startupAnimationStarted=0, lastAnimationFrame=0;

// Smoothstep in integer fixed-point: 0..256 in, 0..256 out.
uint16_t logoEase(unsigned long elapsed,unsigned long duration) {
  if(elapsed>=duration) return 256;
  uint32_t t=elapsed*256UL/duration;
  return (t*t*(768UL-2UL*t))/65536UL;
}
void renderStartupLogo(unsigned long elapsed) {
  largeOLED.clearBuffer();
  uint16_t assemble=elapsed>LOGO_RISE_END ?
    logoEase(elapsed-LOGO_RISE_END,LOGO_ASSEMBLE_MS):0;
  for(byte letter=0;letter<5;letter++) {
    unsigned long begins=(unsigned long)letter*LETTER_RISE_MS;
    if(elapsed<begins) continue;
    uint16_t rise=logoEase(elapsed-begins,LETTER_RISE_MS);
    // All geometry stays signed until pixels are clipped to the screen.
    int16_t top=64-(45L*rise+128)/256;
    int16_t startX=3+26*letter, finalX=14+21*letter;
    int16_t anchorX=startX+((long)(finalX-startX)*assemble)/256;
    int16_t anchorY=top+(3L*assemble+128)/256;
    int16_t stepQ=1024-assemble; // Pixel pitch: 4 -> 3 screen pixels.
    byte size=assemble<192?2:3;  // Final blocks join edge-to-edge.
    for(byte row=0;row<7;row++) {
      byte bits=pgm_read_byte(&logoRows[letter][row]);
      for(byte col=0;col<5;col++) if(bits&(1<<(4-col))) {
        int16_t x=anchorX+(col*stepQ+128)/256;
        int16_t y=anchorY+(row*stepQ+128)/256;
        if(x>=0 && x<128 && y>=0 && y<64) {
          byte w=min((int)size,128-x), h=min((int)size,64-y);
          largeOLED.drawBox(x,y,w,h);
        }
      }
    }
  }
}


// Bitmaps stay in flash, not the Mega's 8 KB RAM.
const byte AIR_FRAME_COUNT=40;
const uint8_t airFramesA[20][1024] PROGMEM={
  {0x00,0x00,0x00,0x00,0x00,0x00,0x00,0x00,0x00,0x00,0x00,0x00,0x00,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0x00,0x00},
  {0x00,0x00,0x00,0x00,0x00,0x00,0x00,0x00,0x00,0x00,0x00,0x00,0x00,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0x00,0x00},
  {0x00,0x00,0x00,0x00,0x00,0x00,0x00,0x00,0x00,0x00,0x00,0x00,0x00,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0x00,0x00},
  {0x00,0x00,0x00,0x00,0x00,0x00,0x00,0x00,0x00,0x00,0x00,0x00,0x00,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0x00,0x00},
  {0x00,0x00,0x00,0x00,0x00,0x00,0x00,0x00,0x00,0x00,0x00,0x00,0x00,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0x00,0x00},
  {0x00,0x00,0x00,0x00,0x00,0x00,0x00,0x00,0x00,0x00,0x00,0x00,0x00,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0x00,0x00},
  {0x00,0x00,0x00,0x00,0x00,0x00,0x00,0x00,0x00,0x00,0x00,0x00,0x00,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0x00,0x00},
  {0x00,0x00,0x00,0x00,0x00,0x00,0x00,0x00,0x00,0x00,0x00,0x00,0x00,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0x00,0x00},
  {0x00,0x00,0x00,0x00,0x00,0x00,0x00,0x00,0x00,0x00,0x00,0x00,0x00,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0x00,0x00},
  {0x00,0x00,0x00,0x00,0x00,0x00,0x00,0x00,0x00,0x00,0x00,0x00,0x00,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0x00,0x00},
  {0x00,0x00,0x00,0x00,0x00,0x00,0x00,0x00,0x00,0x00,0x00,0x00,0x00,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0x00,0x00},
  {0x00,0x00,0x00,0x00,0x00,0x00,0x00,0x00,0x00,0x00,0x00,0x00,0x00,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0x00,0x00},
  {0x00,0x00,0x00,0x00,0x00,0x00,0x00,0x00,0x00,0x00,0x00,0x00,0x00,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0x00,0x00},
  {0x00,0x00,0x00,0x00,0x00,0x00,0x00,0x00,0x00,0x00,0x00,0x00,0x00,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0x00,0x00},
  {0x00,0x00,0x00,0x00,0x00,0x00,0x00,0x00,0x00,0x00,0x00,0x00,0x00,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0x00,0x00},
  {0x00,0x00,0x00,0x00,0x00,0x00,0x00,0x00,0x00,0x00,0x00,0x00,0x00,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0x00,0x00},
  {0x00,0x00,0x00,0x00,0x00,0x00,0x00,0x00,0x00,0x00,0x00,0x00,0x00,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0x00,0x00},
  {0x00,0x00,0x00,0x00,0x00,0x00,0x00,0x00,0x00,0x00,0x00,0x00,0x00,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0x00,0x00},
  {0x00,0x00,0x00,0x00,0x00,0x00,0x00,0x00,0x00,0x00,0x00,0x00,0x00,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0x00,0x00},
  {0x00,0x00,0x00,0x00,0x00,0x00,0x00,0x00,0x00,0x00,0x00,0x00,0x00,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0x00,0x00}
};
const uint8_t airFramesB[20][1024] PROGMEM={
  {0x00,0x00,0x00,0x00,0x00,0x00,0x00,0x00,0x00,0x00,0x00,0x00,0x00,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0x00,0x00},
  {0x00,0x00,0x00,0x00,0x00,0x00,0x00,0x00,0x00,0x00,0x00,0x00,0x00,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0x00,0x00},
  {0x00,0x00,0x00,0x00,0x00,0x00,0x00,0x00,0x00,0x00,0x00,0x00,0x00,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0x00,0x00},
  {0x00,0x00,0x00,0x00,0x00,0x00,0x00,0x00,0x00,0x00,0x00,0x00,0x00,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0x00,0x00},
  {0x00,0x00,0x00,0x00,0x00,0x00,0x00,0x00,0x00,0x00,0x00,0x00,0x00,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0x00,0x00},
  {0x00,0x00,0x00,0x00,0x00,0x00,0x00,0x00,0x00,0x00,0x00,0x00,0x00,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0x00,0x00},
  {0x00,0x00,0x00,0x00,0x00,0x00,0x00,0x00,0x00,0x00,0x00,0x00,0x00,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0x00,0x00},
  {0x00,0x00,0x00,0x00,0x00,0x00,0x00,0x00,0x00,0x00,0x00,0x00,0x00,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0x00,0x00},
  {0x00,0x00,0x00,0x00,0x00,0x00,0x00,0x00,0x00,0x00,0x00,0x00,0x00,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0x00,0x00},
  {0x00,0x00,0x00,0x00,0x00,0x00,0x00,0x00,0x00,0x00,0x00,0x00,0x00,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0x00,0x00},
  {0x00,0x00,0x00,0x00,0x00,0x00,0x00,0x00,0x00,0x00,0x00,0x00,0x00,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0x00,0x00},
  {0x00,0x00,0x00,0x00,0x00,0x00,0x00,0x00,0x00,0x00,0x00,0x00,0x00,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0x00,0x00},
  {0x00,0x00,0x00,0x00,0x00,0x00,0x00,0x00,0x00,0x00,0x00,0x00,0x00,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0x00,0x00},
  {0x00,0x00,0x00,0x00,0x00,0x00,0x00,0x00,0x00,0x00,0x00,0x00,0x00,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0x00,0x00},
  {0x00,0x00,0x00,0x00,0x00,0x00,0x00,0x00,0x00,0x00,0x00,0x00,0x00,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0x00,0x00},
  {0x00,0x00,0x00,0x00,0x00,0x00,0x00,0x00,0x00,0x00,0x00,0x00,0x00,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0x00,0x00},
  {0x00,0x00,0x00,0x00,0x00,0x00,0x00,0x00,0x00,0x00,0x00,0x00,0x00,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0x00,0x00},
  {0x00,0x00,0x00,0x00,0x00,0x00,0x00,0x00,0x00,0x00,0x00,0x00,0x00,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0x00,0x00},
  {0x00,0x00,0x00,0x00,0x00,0x00,0x00,0x00,0x00,0x00,0x00,0x00,0x00,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0x00,0x00},
  {0x00,0x00,0x00,0x00,0x00,0x00,0x00,0x00,0x00,0x00,0x00,0x00,0x00,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0x00,0x00}
};
const uint8_t planetFrames[32][128] PROGMEM={
  {0x00,0x00,0x00,0x00,0x00,0xf0,0x0f,0x00,0x00,0x46,0x70,0x00,0x00,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0x00,0x00},
  {0x00,0x00,0x00,0x00,0x00,0xf0,0x0f,0x00,0x00,0x16,0x64,0x00,0x00,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0x00,0x00},
  {0x00,0x00,0x00,0x00,0x00,0xf0,0x0f,0x00,0x00,0x3e,0x62,0x00,0x00,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0x00,0x00},
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  {0x00,0x00,0x00,0x00,0x00,0xf0,0x0f,0x00,0x00,0xce,0x70,0x00,0x00,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0x00,0x00}
};

// UART protocol (9600 baud, newline terminated):
// Mega broadcasts SW=0 / SW=1 to BOTH Serial1 and Serial3.
// 1 means D23 is closed to GND (LCD numeric view); 0 means open (bar view).
// SAMPLE=1 means the 30-second fan cycle is running; SAMPLE=0 means idle.
// Both states are repeated once per second, and on changes / fan start / stop.
// A compatible Uno should reply ACK after accepting each state packet.
// Compatible with the updated SGP30 and magnetometer/AS7341 Uno sketches.
const byte LCD_SWITCH=23, OLED_BUTTON=24;
const unsigned long HOLD_MS=2000UL, AIR_ANIMATION_MS=6000UL;
const float BATTERY_NOMINAL_WH=12.8f*5.0f;
enum UiPage { HOME, OPTIONS, POWER, DEBUGGING, SOUNDS };
UiPage page=HOME;
byte menuSelection=0, soundSelection=0;
const byte DEBUG_LAST=14;
byte debugPage=0,startupTune=2,airTune=7;
bool muted=false;
const char tuneNames[12][17] PROGMEM={
  "Orbital Dawn","Mission Control","Star Ladder","Deep Space",
  "Retro Boot","Quiet Welcome","Launch Sequence","ORBIT Signature",
  "Scan Chirps","Radar Sweep","Lab Sequence","Minimal Sample"
};
bool switchClosed=false, switchRaw=false, stateDirty=true;
unsigned long switchChanged=0, lastStateTx=0, lastLargeFrame=0;
unsigned long lastAck1=0,lastAck3=0;
bool ackSeen1=false,ackSeen3=false;
char rx1[96]={0},rx3[96]={0};
byte rxLen1=0,rxLen3=0;
bool rxDiscard1=false,rxDiscard3=false;
float smoothedWatts=0;
bool loadEstimateReady=false;

void serviceControls();
void startFans();
void stopSound();
void startSound(byte index,bool repeat);
void serviceSound();
void rgb(bool green,bool blue);
void sendOLED(U8G2 &screen);
int batteryPercent();

// Versioned telemetry from the two Uno sketches. Identify sensor records by
// packet type, so swapping the Uno serial ports still works.
struct RemoteBus {
  byte sda,scl,timeout,sw,sample;
  uint16_t overflows,bad;
  unsigned long busAt,ctrlAt;
  bool busSeen,ctrlSeen;
};
RemoteBus remoteBus[2]={};
long gasData[9]={},magData[9]={},specLow[9]={},specHigh[9]={};
long flickerData[3]={};
unsigned long gasAt=0,magAt=0,lowAt=0,highAt=0,flickerAt=0;
bool gasSeen=false,magSeen=false,lowSeen=false,highSeen=false,flickerSeen=false;
byte gasPort=255,magPort=255,lowPort=255,highPort=255,flickerPort=255;
uint16_t parseErrors[2]={0,0};
unsigned long rxByteAt[2]={0,0};
const uint16_t bandNM[8] PROGMEM={415,445,480,515,555,590,630,680};
const char bandNames[8][13] PROGMEM={"Violet","Blue","Blue-cyan","Green","Yellow-green","Amber","Red","Deep red"};
void countParseError(byte port) {if(parseErrors[port]<65535U) ++parseErrors[port];}
bool flag(long n) {return n==0 || n==1;}
bool rawCount(long n) {return n>=-1 && n<=65535L;}
bool fresh(bool seen,unsigned long at,unsigned long limit=3500UL) {
  return seen && millis()-at<limit;
}
void parseTelemetry(char *line,byte port) {
  if(strcmp(line,"ACK")==0) {
    if(port==0) {ackSeen1=true;lastAck1=millis();}
    else {ackSeen3=true;lastAck3=millis();}
    return;
  }
  char *comma=strchr(line,',');
  if(!comma) {countParseError(port);return;}
  *comma=0;char *cursor=comma+1;
  long v[9];byte n=0;
  while(*cursor && n<9) {
    // Strict decimal fields: reject missing fields, suffixes and overflow.
    if(!(*cursor>='0' && *cursor<='9') && *cursor!='-') {countParseError(port);return;}
    char *end;errno=0;v[n++]=strtol(cursor,&end,10);
    if(errno==ERANGE || end==cursor || (*end!=',' && *end)) {countParseError(port);return;}
    if(!*end) {cursor=end;break;}
    cursor=end+1;if(!*cursor) {countParseError(port);return;}
  }
  if(*cursor || !n || v[0]!=1) {countParseError(port);return;}
  unsigned long now=millis();bool ok=false;
  if(strcmp(line,"SGP")==0 && n==9) {
    ok=flag(v[1])&&flag(v[2])&&flag(v[3])&&flag(v[4]);
    for(byte i=5;i<9;i++) ok=ok&&rawCount(v[i]);
    if(ok) {memcpy(gasData,v,sizeof(v));gasAt=now;gasSeen=true;gasPort=port;}
  } else if(strcmp(line,"MAG")==0 && n==9) {
    ok=flag(v[1])&&flag(v[2])&&flag(v[3]);
    for(byte i=4;i<9;i++) ok=ok&&(v[i]==-32768L || (v[i]>=-10000L && v[i]<=10000L));
    if(ok) {memcpy(magData,v,sizeof(v));magAt=now;magSeen=true;magPort=port;}
  } else if((strcmp(line,"SP1")==0 || strcmp(line,"SP2")==0) && n==9) {
    ok=flag(v[1])&&flag(v[2]);
    for(byte i=3;i<9;i++) ok=ok&&rawCount(v[i]);
    if(ok && strcmp(line,"SP1")==0) {memcpy(specLow,v,sizeof(v));lowAt=now;lowSeen=true;lowPort=port;}
    else if(ok) {memcpy(specHigh,v,sizeof(v));highAt=now;highSeen=true;highPort=port;}
  } else if(strcmp(line,"FLK")==0 && n==3) {
    ok=flag(v[1])&&(v[2]==-1 || v[2]==0 || v[2]==1 || v[2]==100 || v[2]==120);
    if(ok) {memcpy(flickerData,v,sizeof(flickerData));flickerAt=now;flickerSeen=true;flickerPort=port;}
  } else if(strcmp(line,"BUS")==0 && n==6) {
    ok=flag(v[1])&&flag(v[2])&&flag(v[3])&&v[4]>=0&&v[4]<=65535L&&v[5]>=0&&v[5]<=65535L;
    if(ok) {RemoteBus &b=remoteBus[port];b.sda=v[1];b.scl=v[2];b.timeout=v[3];b.overflows=v[4];b.bad=v[5];b.busAt=now;b.busSeen=true;}
  } else if(strcmp(line,"CTRL")==0 && n==3) {
    ok=flag(v[1])&&flag(v[2]);
    if(ok) {RemoteBus &b=remoteBus[port];b.sw=v[1];b.sample=v[2];b.ctrlAt=now;b.ctrlSeen=true;}
  }
  if(!ok) countParseError(port);
}
void readTelemetry(HardwareSerial &port,char *buffer,byte &length,bool &discard,byte index) {
  if(length && millis()-rxByteAt[index]>250UL) {length=0;discard=true;countParseError(index);}
  byte budget=64;
  while(budget-- && port.available()) {
    char ch=port.read();rxByteAt[index]=millis();
    if(ch=='\r') continue;
    if(ch=='\n') {
      buffer[length]=0;
      if(!discard && length) parseTelemetry(buffer,index);
      length=0;discard=false;
    } else if(!discard) {
      if(length<95) buffer[length++]=ch;
      else {length=0;discard=true;countParseError(index);}
    }
  }
}
bool spectrumUsable() {
  if(!fresh(lowSeen,lowAt) || !fresh(highSeen,highAt) || lowPort!=highPort ||
     !specLow[1] || !specLow[2] || !specHigh[1] || !specHigh[2]) return false;
  // The Uno sends its two channel groups adjacent to each other. Reject mixed
  // old/new frames (including a dropped group), rather than blending snapshots.
  if((unsigned long)(highAt-lowAt)>500UL) return false;
  for(byte i=3;i<9;i++) if(specLow[i]<0 || specHigh[i]<0) return false;
  return true;
}
long lightBand(byte i) {return i<4?specLow[3+i]:specHigh[3+i-4];}
void lightSummary(char *color,char *place,char *timeLabel,uint16_t &wave) {
  strcpy(color,"No spectrum");strcpy(place,"Link / sensor?");strcpy(timeLabel,"Waiting...");wave=0;
  if(!spectrumUsable()) return;
  long clear=specHigh[7],nir=specHigh[8],peak=0;byte strongest=0,broad=0;
  bool clipped=false;
  for(byte i=3;i<9;i++) if(specLow[i]>=18000 || specHigh[i]>=18000) clipped=true;
  for(byte i=0;i<8;i++) if(lightBand(i)>peak) {peak=lightBand(i);strongest=i;}
  strcpy(place,"Location unsure");strcpy(timeLabel,"Mixed light?");
  if(clipped) {strcpy(color,"Too bright");strcpy(timeLabel,"Sensor saturated");return;}
  if(clear<50 || peak<20) {strcpy(color,"Too little light");strcpy(timeLabel,"Night / dark?");return;}
  strcpy_P(color,bandNames[strongest]);wave=pgm_read_word(&bandNM[strongest]);
  for(byte i=0;i<8;i++) if(lightBand(i)>peak/5) ++broad;
  uint32_t irPercent=(uint32_t)nir*100UL/((uint32_t)clear+1);
  bool flickering=fresh(flickerSeen,flickerAt) && flickerPort==lowPort && flickerData[1] && flickerData[2]>0;
  // Uncalibrated heuristics at fixed 16x gain. Artificial lamps, windows,
  // shadows and moonlight can fool every branch. '?' is intentional.
  if(flickering) {strcpy(place,"Indoors?");strcpy(timeLabel,"Flickering lamp");}
  else if(irPercent>=15 && broad>=6) {
    strcpy(place,"Outdoors?");
    strcpy(timeLabel,clear>=6000?"Daylight?":clear<800?"Night / dusk?":"Time unsure");
  } else if(irPercent<=5 && clear>=100) {strcpy(place,"Indoors?");strcpy(timeLabel,"Lamp-like light");}
}

void serviceLink() {
  unsigned long now=millis();
  bool raw=digitalRead(LCD_SWITCH)==LOW;
  if(raw!=switchRaw) {switchRaw=raw; switchChanged=now;}
  if(now-switchChanged>=40 && switchClosed!=raw) {
    switchClosed=raw; stateDirty=true; lastDisplay=now-1000UL;
  }
  readTelemetry(Serial1,rx1,rxLen1,rxDiscard1,0);
  readTelemetry(Serial3,rx3,rxLen3,rxDiscard3,1);
  if(!stateDirty && now-lastStateTx<1000UL) return;
  char packet[20];
  int n=snprintf(packet,sizeof(packet),"SW=%u\nSAMPLE=%u\n",switchClosed?1:0,fans?1:0);
  // Never block the fan timer or UI waiting for UART buffer space.
  if(Serial1.availableForWrite()<n || Serial3.availableForWrite()<n) return;
  Serial1.write((const uint8_t*)packet,n);
  Serial3.write((const uint8_t*)packet,n);
  lastStateTx=now; stateDirty=false;
}
void saveSoundSettings() {
  // Invalidate before writing, so interrupted writes cannot masquerade as saved.
  EEPROM.update(16,0);EEPROM.update(17,startupTune);
  EEPROM.update(18,airTune);EEPROM.update(19,muted?1:0);EEPROM.update(16,0xD4);
}
void loadSoundSettings() {
  if(EEPROM.read(16)==0xD4 && EEPROM.read(17)<12 && EEPROM.read(18)<12 && EEPROM.read(19)<=1) {
    startupTune=EEPROM.read(17);airTune=EEPROM.read(18);muted=EEPROM.read(19);
  } else {
    // Migrate the previous global Star Ladder/mute choice when available.
    if(EEPROM.read(6)==0xB3) {
      if(EEPROM.read(7)==1) {startupTune=2;airTune=2;}
      muted=EEPROM.read(7)==2;
    }
    saveSoundSettings();
  }
}
void selectMenu() {
  if(page==HOME) {page=OPTIONS; menuSelection=0;}
  else if(page==OPTIONS) {
    if(menuSelection==0) page=POWER;
    else if(menuSelection==1) {page=DEBUGGING;debugPage=0;}
    else if(menuSelection==2) {page=SOUNDS; soundSelection=0;}
    else page=HOME;
  } else if(page==SOUNDS) {
    if(soundSelection==3) page=OPTIONS;
    else if(soundSelection==2) {muted=!muted;stopSound();saveSoundSettings();}
    else {
      byte &choice=soundSelection==0?startupTune:airTune;
      choice=(choice+1)%12;saveSoundSettings();
      // Explicit audition plays once even if routine event sounds are muted.
      startSound(choice,false);
    }
  } else if(page==DEBUGGING) {
    if(debugPage==DEBUG_LAST) page=OPTIONS;
  } else page=OPTIONS;
  lastLargeFrame=millis()-120UL;
}
void shortPress() {
  if(startupAnimating) return;
  if(page==OPTIONS) menuSelection=(menuSelection+1)%4;
  else if(page==SOUNDS) soundSelection=(soundSelection+1)%4;
  else if(page==DEBUGGING) debugPage=(debugPage+1)%(DEBUG_LAST+1);
  // Power page has a single Go back item; hold selects it.
  lastLargeFrame=millis()-120UL;
}
void serviceControls() {
  unsigned long now=millis();
  static byte lastRaw=HIGH,stable=HIGH;
  static unsigned long changed=0,pressedAt=0;
  static bool held=false,ignoreUntilRelease=false;
  // D6 is independent: start on a debounced press, never on menu activity.
  static byte fanRaw=HIGH,fanStable=HIGH;
  static unsigned long fanChanged=0;
  byte fanInput=digitalRead(FAN_BUTTON);
  if(fanInput!=fanRaw) {fanRaw=fanInput;fanChanged=now;}
  if(now-fanChanged>=30 && fanInput!=fanStable) {
    fanStable=fanInput;
    if(fanStable==LOW && !fans && !startupAnimating) startFans();
  }
  // D24 has its own debounce / hold state and cannot start the fans.
  byte raw=digitalRead(OLED_BUTTON);
  if(raw!=lastRaw) {lastRaw=raw; changed=now;}
  if(now-changed>=30 && raw!=stable) {
    stable=raw;
    if(stable==LOW) {pressedAt=now;held=false;ignoreUntilRelease=startupAnimating;}
    else {
      if(!held && !ignoreUntilRelease) shortPress();
      ignoreUntilRelease=false;
    }
  }
  if(stable==LOW && !held && !ignoreUntilRelease && now-pressedAt>=HOLD_MS) {
    held=true; selectMenu();
  }
  if(fans && now-fanStarted>=FAN_MS) {
    fans=false; digitalWrite(FAN1,LOW); digitalWrite(FAN2,LOW);
    stateDirty=true;
  }
  if(fans) {bool phase=((now-fanStarted)/FLASH_MS)%2==0;rgb(phase,!phase);}
  else rgb(false,false);
  serviceSound(); serviceLink();
}
long remainingMinutes() {
  int percent=batteryPercent();
  if(percent<0 || !loadEstimateReady || !powerValid || currentMA<=0 || smoothedWatts<0.1f) return -1;
  float minutes=BATTERY_NOMINAL_WH*(percent/100.0f)*60.0f/smoothedWatts;
  // Coarse five-minute rounding. This is a voltage-based guess, not a fuel gauge.
  return (long)(min(minutes,59995.0f)/5.0f+0.5f)*5L;
}
void runtimeText(char* buffer,size_t size) {
  long minutes=remainingMinutes();
  if(minutes<0) snprintf(buffer,size,"~--h--m");
  else snprintf(buffer,size,"~%ldh%02ldm",minutes/60,minutes%60);
}
void heading(const char *label) {
  largeOLED.setFont(u8g2_font_5x7_tf);
  largeOLED.drawStr(1,7,label);largeOLED.drawHLine(0,10,128);
}
void optionRow(const char* label,byte row,bool selected) {
  byte baseline=22+row*12;
  if(selected) {largeOLED.drawBox(0,baseline-8,128,11);largeOLED.setDrawColor(0);}
  largeOLED.drawStr(3,baseline,label);largeOLED.setDrawColor(1);
}
void debugLine(byte row,const char *label,long value) {
  largeOLED.setCursor(0,20+row*10);largeOLED.print(label);largeOLED.print(value);
}
void debugText(byte row,const char *value) {largeOLED.drawStr(0,20+row*10,value);}
void debugMag(byte row,const char *label,long value) {
  largeOLED.setCursor(0,20+row*10);largeOLED.print(label);
  if(value==-32768L) largeOLED.print(F("--"));else largeOLED.print(value/10.0f,1);
  largeOLED.print(F(" uT"));
}
void renderDebug() {
  char line[26];unsigned long now=millis();
  if(debugPage==DEBUG_LAST) {
    heading("DEBUGGING / END");
    debugText(0,"End of diagnostics");debugText(2,"Hold 2s to return");
    optionRow("Go back",3,true);return;
  }
  switch(debugPage) {
    case 0:
      heading("01 LINKS");
      debugText(0,fresh(ackSeen1,lastAck1)?"UART1: ACK OK":"UART1: NO REPLY");
      debugText(1,fresh(ackSeen3,lastAck3)?"UART3: ACK OK":"UART3: NO REPLY");
      debugLine(2,"RX1 parse errors: ",parseErrors[0]);debugLine(3,"RX3 parse errors: ",parseErrors[1]);break;
    case 1:
      heading("02 MEGA CLIMATE / I2C");
      if(climateValid) {
        largeOLED.setCursor(0,20);largeOLED.print(F("Temp "));largeOLED.print(tempF,1);largeOLED.print(F(" F"));
        largeOLED.setCursor(0,30);largeOLED.print(F("Humidity "));largeOLED.print(humidity,1);largeOLED.print('%');
      } else debugText(0,"AHT30 NO VALID DATA");
      snprintf(line,sizeof(line),"SDA A4:%u SCL A5:%u",digitalRead(SDA_PIN),digitalRead(SCL_PIN));debugText(2,line);
      snprintf(line,sizeof(line),"LCD:%u OLEDs:%u/%u",lcdOK,smallOK,largeOK);debugText(3,line);break;
    case 2:
      heading("03 MEGA POWER");
      if(powerValid) {
        largeOLED.setCursor(0,20);largeOLED.print(batteryV,2);largeOLED.print(F(" V / "));largeOLED.print(currentMA,0);largeOLED.print(F(" mA"));
        largeOLED.setCursor(0,30);largeOLED.print(watts,2);largeOLED.print(F(" W"));
      } else debugText(0,powerOverflow?"INA219 OVER RANGE":"INA219 NO VALID DATA");
      largeOLED.setCursor(0,40);largeOLED.print(usedMAh,1);largeOLED.print(F(" mAh since boot"));
      largeOLED.setCursor(0,50);largeOLED.print(usedWh,2);largeOLED.print(F(" Wh since boot"));break;
    case 3:
      heading("04 SGP30");
      if(!fresh(gasSeen,gasAt)) {debugText(0,"NO DATA / STALE");break;}
      snprintf(line,sizeof(line),"Init:%ld IAQ:%ld Raw:%ld",gasData[1],gasData[2],gasData[3]);debugText(0,line);
      if(gasData[4]) debugText(1,"Sensor warming up");
      else {snprintf(line,sizeof(line),"eCO2:%ld TVOC:%ld",gasData[2]?gasData[5]:-1L,gasData[2]?gasData[6]:-1L);debugText(1,line);}
      debugLine(2,"H2 raw: ",gasData[3]?gasData[7]:-1L);debugLine(3,"EtOH raw: ",gasData[3]?gasData[8]:-1L);break;
    case 4:
      heading("05 MAGNETOMETER");
      if(!fresh(magSeen,magAt) || !magData[2]) {debugText(0,"NO VALID MAG DATA");break;}
      debugMag(0,"X ",magData[4]);debugMag(1,"Y ",magData[5]);debugMag(2,"Z ",magData[6]);debugMag(3,"Total ",magData[7]);break;
    case 5: case 6: {
      heading(debugPage==5?"06 SPECTRUM F1-F4":"07 SPECTRUM F5-F8");
      if(!spectrumUsable()) {debugText(0,"NO DATA / STALE");break;}
      byte offset=debugPage==5?0:4;
      for(byte i=0;i<4;i++) {snprintf(line,sizeof(line),"F%u %unm: %ld",offset+i+1,pgm_read_word(&bandNM[offset+i]),lightBand(offset+i));debugText(i,line);}break;
    }
    case 7:
      heading("08 CLEAR / NIR / FLICKER");
      if(spectrumUsable()) {
        snprintf(line,sizeof(line),"Clear L/H:%ld/%ld",specLow[7],specHigh[7]);debugText(0,line);
        snprintf(line,sizeof(line),"NIR L/H: %ld/%ld",specLow[8],specHigh[8]);debugText(1,line);
      } else debugText(0,"SPECTRUM DATA STALE");
      if(fresh(flickerSeen,flickerAt) && flickerData[1]) {
        if(flickerData[2]==0) debugText(2,"100/120Hz: not found");
        else if(flickerData[2]==1) debugText(2,"Flicker: Hz unknown");
        else {snprintf(line,sizeof(line),"Flicker: %ld Hz",flickerData[2]);debugText(2,line);}
      } else debugText(2,"Flicker: unavailable");
      debugText(3,"Raw counts, gain 16x");break;
    case 8: {
      heading("09 LIGHT ESTIMATE");
      char color[18],place[18],timeLabel[18];uint16_t wave;
      lightSummary(color,place,timeLabel,wave);
      debugText(0,color);debugText(1,place);debugText(2,timeLabel);
      debugText(3,"Guess, not location");break;
    }
    case 9: case 10: {
      byte port=debugPage==9?0:1;RemoteBus &b=remoteBus[port];
      heading(port==0?"10 UNO BUS / UART1":"11 UNO BUS / UART3");
      if(!fresh(b.busSeen,b.busAt)) {debugText(0,"NO BUS DATA / STALE");break;}
      snprintf(line,sizeof(line),"Idle SDA:%u SCL:%u",b.sda,b.scl);debugText(0,line);
      debugLine(1,"Timeout since boot: ",b.timeout);
      debugLine(2,"Uno RX overflows: ",b.overflows);debugLine(3,"Uno bad commands: ",b.bad);break;
    }
    case 11:
      heading("12 CONTROLS / REFERENCE");
      snprintf(line,sizeof(line),"D23:%u Fan:%u Mute:%u",switchClosed,fans,muted);debugText(0,line);
      for(byte i=0;i<2;i++) {
        RemoteBus &b=remoteBus[i];
        if(fresh(b.ctrlSeen,b.ctrlAt)) snprintf(line,sizeof(line),"Uno%u SW:%u Sample:%u",i+1,b.sw,b.sample);
        else snprintf(line,sizeof(line),"Uno%u control: STALE",i+1);
        debugText(i+1,line);
      }
      if(fresh(magSeen,magAt) && magData[3]) debugMag(3,"Ref ",magData[8]);
      else debugText(3,"Mag reference: waiting");break;
    case 12:
      heading("13 BMP280 READINGS");
      if(bmpValid && fresh(bmpSeen,lastBMPGood)) {
        largeOLED.setCursor(0,20);largeOLED.print(F("Pressure "));largeOLED.print(pressureHPA,1);largeOLED.print(F(" hPa"));
        largeOLED.setCursor(0,30);largeOLED.print(F("Altitude ~"));largeOLED.print(altitudeFT,0);largeOLED.print(F(" ft"));
        largeOLED.setCursor(0,40);largeOLED.print(F("BMP temp "));largeOLED.print(bmpTempF,1);largeOLED.print(F(" F"));
      } else debugText(0,bmpOK?"NO VALID DATA / STALE":"BMP280 NOT INITIALIZED");
      largeOLED.setCursor(0,50);largeOLED.print(F("QNH "));largeOLED.print(SEA_LEVEL_HPA,2);largeOLED.print(F(" hPa"));break;
    case 13:
      heading("14 BMP280 HARDWARE I2C");
      if(bmpAddress) snprintf(line,sizeof(line),"Addr:0x%02X Init:%u",bmpAddress,bmpOK);
      else snprintf(line,sizeof(line),"No BMP at 0x76 / 0x77");
      debugText(0,line);
      snprintf(line,sizeof(line),"SDA20:%u SCL21:%u",digitalRead(20),digitalRead(21));debugText(1,line);
      snprintf(line,sizeof(line),"Errors:%u Timeout:%u",bmpErrors,bmpTimeoutSeen);debugText(2,line);
      if(bmpSeen) snprintf(line,sizeof(line),"Last good: %lus ago",(now-lastBMPGood)/1000UL);
      else snprintf(line,sizeof(line),"Last good: never");
      debugText(3,line);break;
  }
  largeOLED.drawHLine(0,54,128);largeOLED.drawStr(0,63,"Tap: next  (-1=no data)");
}
void drawSecondaryStartup(unsigned long elapsed) {
  static byte lastRemaining=255;
  byte remaining=elapsed<5000UL?(5000UL-elapsed+999UL)/1000UL:0;
  if(remaining==lastRemaining) return;lastRemaining=remaining;
  char line[17];snprintf(line,sizeof(line),"Starting in %us",remaining);
  if(lcdOK) {lcdLine(0,"O.R.B.I.Tstartup");lcdLine(1,line);}
  if(smallOK) {
    smallOLED.clearBuffer();smallOLED.setFont(u8g2_font_6x10_tf);
    smallOLED.drawStr(0,12,"O.R.B.I.Tstartup");smallOLED.drawStr(0,30,line);
    sendOLED(smallOLED);
  }
}

void renderLargeUI() {
  largeOLED.clearBuffer();largeOLED.setDrawColor(1);largeOLED.setFont(u8g2_font_5x7_tf);
  unsigned long now=millis(),elapsed=now-fanStarted;
  // The saved propeller + side text rise together; no separate ending message.
  if(fans && elapsed<AIR_ANIMATION_MS) {
    byte frame=min((unsigned long)(AIR_FRAME_COUNT-1),elapsed/150UL);
    largeOLED.drawXBMP(0,0,128,64,frame<20?airFramesA[frame]:airFramesB[frame-20]);
    return;
  }
  char line[26],timeText[16];
  if(page==HOME) {
    // Spectrometer owns the larger left section; planet sits middle-right.
    largeOLED.drawVLine(91,0,53);largeOLED.drawHLine(0,53,128);
    largeOLED.drawXBMP(96,11,32,32,planetFrames[(now/150UL)%32]);
    char color[18],place[18],timeLabel[18];uint16_t wave;
    lightSummary(color,place,timeLabel,wave);
    largeOLED.drawStr(1,7,"SPECTROMETER");largeOLED.drawStr(1,19,color);
    if(wave) snprintf(line,sizeof(line),"Peak %u nm",wave);
    else snprintf(line,sizeof(line),"Peak -- nm");
    largeOLED.drawStr(1,29,line);largeOLED.drawStr(1,40,place);largeOLED.drawStr(1,50,timeLabel);
    int pct=batteryPercent();
    if(pct<0) snprintf(line,sizeof(line),"--%%");
    else snprintf(line,sizeof(line),"~%d%%",pct);
    largeOLED.drawStr(0,63,line);
    largeOLED.drawFrame(28,56,44,8);
    if(pct>=0) largeOLED.drawBox(30,58,40L*pct/100,4);
    runtimeText(timeText,sizeof(timeText));
    largeOLED.drawStr(128-largeOLED.getStrWidth(timeText),63,timeText);
  } else if(page==OPTIONS) {
    heading("OPTIONS");
    optionRow("Power data",0,menuSelection==0);
    optionRow("Debugging",1,menuSelection==1);
    optionRow("Sound selection",2,menuSelection==2);
    optionRow("Back to home",3,menuSelection==3);
  } else if(page==POWER) {
    heading("POWER DATA (~ESTIMATES)");
    if(powerValid) {
      largeOLED.setCursor(0,20);largeOLED.print(batteryV,2);largeOLED.print(F(" V  "));largeOLED.print(currentMA,0);largeOLED.print(F(" mA"));
      largeOLED.setCursor(0,30);largeOLED.print(watts,2);largeOLED.print(F(" W  ~"));
      int pct=batteryPercent();if(pct>=0) largeOLED.print(pct);else largeOLED.print(F("--"));largeOLED.print('%');
      runtimeText(timeText,sizeof(timeText));largeOLED.drawStr(0,40,timeText);
    } else largeOLED.drawStr(0,22,powerOverflow?"INA219 OVER RANGE":"INA219 NO DATA");
    largeOLED.setCursor(0,50);largeOLED.print(usedWh,2);largeOLED.print(F(" Wh used since boot"));
    optionRow("Go back",3,true);
  } else if(page==DEBUGGING) {
    renderDebug();
  } else {
    char title[26];
    if(soundSelection<2) {
      byte choice=soundSelection==0?startupTune:airTune;
      char name[17];strcpy_P(name,tuneNames[choice]);
      snprintf(title,sizeof(title),"%02u %s",choice+1,name);heading(title);
    } else heading("SOUND SELECTION");
    snprintf(line,sizeof(line),"Start up sound %02u",startupTune+1);optionRow(line,0,soundSelection==0);
    snprintf(line,sizeof(line),"Air Sample sound %02u",airTune+1);optionRow(line,1,soundSelection==1);
    optionRow(muted?"Mute: ON":"Mute: OFF",2,soundSelection==2);
    optionRow("Go back",3,soundSelection==3);
  }
}


bool present(byte address) {
  bus.beginTransmission(address);
  return bus.endTransmission()==0;
}
void rgb(bool green,bool blue) {
  digitalWrite(RGB_G,green ^ RGB_COMMON_ANODE);
  digitalWrite(RGB_B,blue ^ RGB_COMMON_ANODE);
}
void stopSound() {
  noTone(BUZZER); digitalWrite(BUZZER,LOW); sound=NULL;
}
void startSound(byte index,bool repeat) {
  stopSound(); if(index>=12) return;
  sound=tunes[index]; soundWords=lengths[index];
  soundPos=0; soundRepeat=repeat; noteDuration=0; noteStarted=millis();
}
void serviceSound() {
  if(!sound || millis()-noteStarted<noteDuration) return;
  if(soundPos>=soundWords) {
    if(!soundRepeat) {stopSound(); return;}
    soundPos=0;
  }
  uint16_t hz=pgm_read_word(sound+soundPos++);
  noteDuration=pgm_read_word(sound+soundPos++);
  noteStarted=millis();
  if(hz) tone(BUZZER,hz,noteDuration); else noTone(BUZZER);
}
void startFans() {
  fans=true; fanStarted=millis(); stateDirty=true;
  digitalWrite(FAN1,HIGH); digitalWrite(FAN2,HIGH);
  if(!muted) startSound(airTune,false);
  Serial.print(F("Air sample tune: "));Serial.println(airTune+1);
}
// Report the actual failure; never display corrupt data as a valid reading.
void climateError(const __FlashStringHelper* message) {
  climatePending=false;
  climateValid=false;
  Serial.print(F("AHT30: ")); Serial.println(message);
}
void serviceClimate() {
  static unsigned long triggered=0, lastPoll=0;
  unsigned long now=millis();
  if(!ahtOK) return;
  if(!climatePending && now-lastClimate>=2000UL) {
    lastClimate=now;
    bus.beginTransmission(0x38);
    bus.write(0xAC); bus.write(0x33); bus.write(0x00);
    byte error=bus.endTransmission();
    if(error!=0) {
      Serial.print(F("AHT30 command error code: ")); Serial.println(error);
      climateError(F("measurement command failed")); return;
    }
    climatePending=true; triggered=millis(); lastPoll=triggered;
    return;
  }
  if(!climatePending || now-triggered<100 || now-lastPoll<20) return;
  lastPoll=now;
  byte count=bus.requestFrom((byte)0x38,(byte)7);
  if(count!=7) {
    while(bus.available()) bus.read();
    Serial.print(F("AHT30 bytes received: ")); Serial.println(count);
    climateError(F("incomplete read; expected 7 bytes")); return;
  }
  byte data[7]; for(byte i=0;i<7;i++) data[i]=bus.read();
  if(data[0]&0x80) {
    if(now-triggered>=1000UL) climateError(F("busy for over 1 second"));
    return;
  }
  climatePending=false;
  byte crc=0xFF;
  for(byte i=0;i<6;i++) {
    crc^=data[i];
    for(byte bit=0;bit<8;bit++) crc=(crc&0x80)?(crc<<1)^0x31:crc<<1;
  }
  if(crc!=data[6]) {
    Serial.print(F("AHT30 raw:"));
    for(byte i=0;i<7;i++) {Serial.print(' '); Serial.print(data[i],HEX);}
    Serial.print(F(" calculated CRC=")); Serial.println(crc,HEX);
    climateError(F("CRC mismatch")); return;
  }
  if(!(data[0]&0x08)) {
    climateError(F("calibration flag not set")); return;
  }
  uint32_t rh=((uint32_t)data[1]<<12)|((uint32_t)data[2]<<4)|(data[3]>>4);
  uint32_t tr=((uint32_t)(data[3]&15)<<16)|((uint32_t)data[4]<<8)|data[5];
  humidity=rh*(100.0f/1048576.0f);
  tempF=(tr*(200.0f/1048576.0f)-50.0f)*1.8f+32;
  climateValid=true;
  Serial.print(F("AHT30 OK: ")); Serial.print(tempF,1);
  Serial.print(F(" F, ")); Serial.print(humidity,1); Serial.println(F(" %RH"));
}

// BMP280 uses its own hardware bus; never move the OLEDs onto Wire.
// Every transaction is bounded by Wire's timeout on the Mega AVR core.
bool bmpTimeout() {
  bool timedOut=Wire.getWireTimeoutFlag();
  if(timedOut) {bmpTimeoutSeen=true;Wire.clearWireTimeoutFlag();}
  return timedOut;
}
bool bmpRegister(byte address,byte reg,byte &value) {
  Wire.beginTransmission(address);Wire.write(reg);
  if(Wire.endTransmission(false)!=0) {bmpTimeout();return false;}
  byte count=Wire.requestFrom(address,(byte)1);
  bool timedOut=bmpTimeout();
  if(count!=1 || timedOut) {while(Wire.available()) Wire.read();return false;}
  value=Wire.read();return true;
}
void bmpFault() {
  bmpValid=false;bmpOK=false;
  if(bmpErrors<65535U) ++bmpErrors;
}
void beginBMP() {
  lastBMPAttempt=millis();bmpOK=false;bmpValid=false;bmpAddress=0;
  const byte addresses[]={0x77,0x76};
  for(byte i=0;i<2;i++) {
    byte id=0;
    if(!bmpRegister(addresses[i],0xD0,id) || id!=0x58) continue;
    bmpAddress=addresses[i];
    bool initialized=bmp.begin(bmpAddress);
    // Adafruit begin() calls Wire.begin(); restore the bus settings afterward.
    Wire.setClock(100000UL);Wire.setWireTimeout(10000UL,true);
    bool timedOut=bmpTimeout();
    if(!initialized || timedOut) continue;
    // Configure while asleep, then use continuous measurements.
    bmp.setSampling(Adafruit_BMP280::MODE_SLEEP,
      Adafruit_BMP280::SAMPLING_X2,Adafruit_BMP280::SAMPLING_X16,
      Adafruit_BMP280::FILTER_X16,Adafruit_BMP280::STANDBY_MS_500);
    delay(100); // Allow any conversion already in progress to finish in sleep.
    bmp.setSampling(Adafruit_BMP280::MODE_NORMAL,
      Adafruit_BMP280::SAMPLING_X2,Adafruit_BMP280::SAMPLING_X16,
      Adafruit_BMP280::FILTER_X16,Adafruit_BMP280::STANDBY_MS_500);
    byte control=0,config=0;
    if(bmpTimeout() || !bmpRegister(bmpAddress,0xF4,control) ||
       !bmpRegister(bmpAddress,0xF5,config) || control!=0x57 || (config&0xFC)!=0x90) continue;
    bmpOK=true;lastBMP=millis();
    Serial.print(F("BMP280 hardware I2C ready at 0x"));Serial.println(bmpAddress,HEX);
    return;
  }
  bmpFault();
  Serial.println(F("BMP280 not ready on D20/D21; retry in 10s"));
}
void serviceBMP() {
  unsigned long now=millis();
  if(!bmpOK) {
    // Retry outside animations / sampling so reinitialization cannot pause them.
    if(!fans && !startupAnimating && now-lastBMPAttempt>=10000UL) beginBMP();
    return;
  }
  if(now-lastBMP<1000UL) return;
  lastBMP=now;
  byte id=0,control=0;
  if(!bmpRegister(bmpAddress,0xD0,id) || id!=0x58 ||
     !bmpRegister(bmpAddress,0xF4,control) || control!=0x57) {bmpFault();return;}
  float pressure=bmp.readPressure()/100.0f;
  float temperature=bmp.readTemperature();
  bool timedOut=bmpTimeout();
  byte check=0;
  if(timedOut || !bmpRegister(bmpAddress,0xD0,check) || check!=0x58 ||
     !isfinite(pressure) || pressure<300.0f || pressure>1100.0f ||
     !isfinite(temperature) || temperature<-40.0f || temperature>85.0f) {bmpFault();return;}
  // Calculate from the same pressure sample displayed on the LCD.
  float altitude=44330.0f*(1.0f-powf(pressure/SEA_LEVEL_HPA,0.1903f))*3.28084f;
  if(!isfinite(altitude)) {bmpFault();return;}
  pressureHPA=pressure;altitudeFT=altitude;bmpTempF=temperature*1.8f+32.0f;
  bmpValid=true;bmpSeen=true;lastBMPGood=millis();
  Serial.print(F("BMP280: "));Serial.print(pressureHPA,1);Serial.print(F(" hPa, ~"));
  Serial.print(altitudeFT,0);Serial.println(F(" ft"));
}

// Generic 4-cell LiFePO4 voltage heuristic, not a Fitinoch calibration.
// Load, temperature and recent charging can substantially change this estimate.
int batteryPercent() {
  if(!powerValid || !batteryEstimateReady || batteryV<9.0f || batteryV>14.8f) return -1;
  const float volts[]={10.0f,12.0f,12.5f,12.8f,12.9f,13.0f,13.1f,13.2f,13.3f,13.6f};
  const byte pct[]={0,9,14,17,20,30,40,70,90,100};
  if(filteredBatteryV<=volts[0]) return 0;
  for(byte i=1;i<10;i++) if(filteredBatteryV<volts[i]) {
    float p=pct[i-1]+(filteredBatteryV-volts[i-1])*
      (pct[i]-pct[i-1])/(volts[i]-volts[i-1]);
    // Round to 5% increments to avoid implying single-percent precision.
    return constrain((int)(p/5.0f+0.5f)*5,0,100);
  }
  return 100;
}

bool readINARegister(byte reg,uint16_t &value) {
  bus.beginTransmission(0x40); bus.write(reg);
  if(bus.endTransmission(false)!=0) return false;
  if(bus.requestFrom((byte)0x40,(byte)2)!=2) return false;
  value=(uint16_t)bus.read()<<8; value|=bus.read(); return true;
}
void servicePower() {
  unsigned long now=millis();
  if(now-lastPower<250) return;
  lastPower=now;
  uint16_t status=0;
  powerValid=false; powerOverflow=false;
  if(inaOK && readINARegister(2,status)) {
    powerOverflow=status&1;
    if(!powerOverflow) {
      uint16_t shuntRaw, currentRaw, calibration, check;
      bool readOK=readINARegister(1,shuntRaw) && readINARegister(4,currentRaw)
        && readINARegister(5,calibration) && readINARegister(2,check);
      powerOverflow=readOK && (check&1);
      if(readOK && !powerOverflow && calibration==4096) {
        float loadV=(status>>3)*0.004f;
        float shunt=(int16_t)shuntRaw*0.01f;
        batteryV=loadV+shunt/1000.0f;
        currentMA=(int16_t)currentRaw*0.1f;
        watts=batteryV*currentMA/1000.0f; powerValid=true;
        float discharge=max(watts,0.0f);
        if(!loadEstimateReady) {smoothedWatts=discharge;loadEstimateReady=true;}
        else smoothedWatts+=0.05f*(discharge-smoothedWatts);
        if(!batteryEstimateReady) {filteredBatteryV=batteryV; batteryEstimateReady=true;}
        else filteredBatteryV+=0.05f*(batteryV-filteredBatteryV);
      }
    }
  }
  // Integrate only adjacent valid samples, avoiding invented usage across faults.
  float ma=powerValid?max(currentMA,0.0f):0;
  float w=powerValid?max(watts,0.0f):0;
  if(powerValid && previousPowerValid && now-lastIntegration<2000UL) {
    float hours=(now-lastIntegration)/3600000.0f;
    usedMAh+=(previousMA+ma)*0.5f*hours;
    usedWh+=(previousW+w)*0.5f*hours;
  }
  previousMA=ma; previousW=w; previousPowerValid=powerValid; lastIntegration=now;
}
const char* climateName() {
  if(tempF<32) return "FREEZING";
  if(tempF<50) return humidity>=65?"COLD & DAMP":"COLD";
  if(tempF>=80 && humidity<35) return "DESERT-LIKE";
  if(tempF>=80 && humidity>=65) return "TROPICAL";
  if(humidity<35) return "DRY AIR";
  if(tempF<65) return humidity>=65?"COOL & DAMP":"COOL";
  if(humidity>=65) return tempF>=75?"WARM & HUMID":"HUMID";
  if(tempF>85) return "HOT";
  if(tempF>77) return "WARM";
  return "COMFORTABLE";
}
// Common PCF8574 LCD backpack: RS=P0, EN=P2, BL=P3, D4..D7=P4..P7.
bool lcdNibble(byte value) {
  bus.beginTransmission(0x27);
  bus.write((byte)(value|0x08));
  bus.write((byte)(value|0x0C));
  bus.write((byte)(value|0x08));
  bool ok=bus.endTransmission()==0;
  delayMicroseconds(50);
  return ok;
}
bool lcdSend(byte value,bool data) {
  byte mode=data?1:0;
  return lcdNibble((value&0xF0)|mode) && lcdNibble((value<<4)|mode);
}
bool lcdBegin() {
  delay(50);
  if(!lcdNibble(0x30)) return false;
  delay(5); lcdNibble(0x30); delay(5); lcdNibble(0x30);
  delay(1); lcdNibble(0x20);
  lcdSend(0x28,false); lcdSend(0x08,false); lcdSend(0x01,false); delay(3);
  lcdSend(0x06,false);
  return lcdSend(0x0C,false);
}
void lcdLine(byte row,const char* text) {
  if(!lcdSend(row?0xC0:0x80,false)) return;
  for(byte n=0;n<16;n++) {
    byte c=*text?(byte)*text++:' ';
    if(!lcdSend(c,true)) return;
    if((n&3)==3) serviceControls();
  }
}
bool writeINARegister(byte reg,uint16_t value) {
  bus.beginTransmission(0x40); bus.write(reg);
  bus.write((byte)(value>>8)); bus.write((byte)value);
  return bus.endTransmission()==0;
}
bool ahtBegin() {
  delay(100);
  if(bus.requestFrom((byte)0x38,(byte)1)!=1) return false;
  byte status=bus.read();
  if(status&0x08) return true;
  bus.beginTransmission(0x38);
  bus.write((byte)0xBE); bus.write((byte)0x08); bus.write((byte)0x00);
  if(bus.endTransmission()!=0) return false;
  delay(20);
  if(bus.requestFrom((byte)0x38,(byte)1)!=1) return false;
  return (bus.read()&0x08)!=0;
}
// Send one tile row at a time so fan/button/sound service runs between rows.
void sendOLED(U8G2 &screen) {
  for(byte row=0;row<8;row++) {
    if(digitalRead(SDA_PIN)==LOW || digitalRead(SCL_PIN)==LOW) break;
    screen.updateDisplayArea(0,row,16,1);
    serviceControls();
  }
}
void drawDisplays() {
  char line[22], number[14];
  if(lcdOK) {
    if(switchClosed) {
      if(bmpValid && fresh(bmpSeen,lastBMPGood)) {
        dtostrf(altitudeFT,1,0,number);snprintf(line,sizeof(line),"Alt: ~%s ft",number);lcdLine(0,line);
        dtostrf(pressureHPA,1,1,number);snprintf(line,sizeof(line),"P: %s hPa",number);lcdLine(1,line);
      } else {lcdLine(0,"BMP280 NO DATA");lcdLine(1,"Check D20 / D21");}
    } else if(climateValid) {
      dtostrf(tempF,5,1,number); snprintf(line,sizeof(line),"Temp: %s F",number); lcdLine(0,line);
      dtostrf(humidity,5,1,number); snprintf(line,sizeof(line),"Humidity:%s%%",number); lcdLine(1,line);
    } else {lcdLine(0,"AHT30 NO DATA"); lcdLine(1,"Check sensor");}
  }
  serviceControls();
  if(smallOK) {
    smallOLED.clearBuffer(); smallOLED.setFont(u8g2_font_6x10_tf);
    smallOLED.drawStr(0,10,"ORBIT ENVIRONMENT");
    smallOLED.drawHLine(0,13,128);
    smallOLED.drawStr(0,29,climateValid?climateName():"SENSOR NO DATA");
    smallOLED.drawStr(0,43,"Based on temp + RH");
    if(fans) {
      unsigned long elapsed=millis()-fanStarted;
      unsigned long left=elapsed<FAN_MS?(FAN_MS-elapsed+999)/1000:0;
      snprintf(line,sizeof(line),"FANS ON: %lus",left);
    } else snprintf(line,sizeof(line),"FANS: STANDBY");
    smallOLED.drawStr(0,60,line); sendOLED(smallOLED);
  }
  serviceControls();

  serviceControls();
}
void setup() {
  digitalWrite(FAN1,LOW); digitalWrite(FAN2,LOW);
  pinMode(FAN1,OUTPUT); pinMode(FAN2,OUTPUT);
  pinMode(POWER_LED,OUTPUT); digitalWrite(POWER_LED,HIGH);
  rgb(false,false); pinMode(RGB_G,OUTPUT); pinMode(RGB_B,OUTPUT);
  pinMode(BUZZER,OUTPUT); stopSound();
  pinMode(FAN_BUTTON,INPUT_PULLUP); pinMode(LCD_SWITCH,INPUT_PULLUP); pinMode(OLED_BUTTON,INPUT_PULLUP);
  loadSoundSettings();
  switchClosed=switchRaw=(digitalRead(LCD_SWITCH)==LOW);
  switchChanged=millis();
  Serial1.begin(9600); Serial3.begin(9600);
  Serial.begin(115200);
  // Separate hardware bus for BMP280; OLEDs remain on A4/A5.
  Wire.begin();Wire.setClock(100000UL);Wire.setWireTimeout(10000UL,true);
  bus.begin(); bus.setClock(50000); bus.setTimeout(5);
  delay(100);
  Serial.println(F("ORBIT SOFTWARE I2C: SDA=A4 SCL=A5"));
  Serial.print(F("Idle SDA=")); Serial.print(digitalRead(SDA_PIN));
  Serial.print(F(" SCL=")); Serial.println(digitalRead(SCL_PIN));
  byte found=0;
  if(digitalRead(SDA_PIN)==HIGH && digitalRead(SCL_PIN)==HIGH) {
    for(byte address=1;address<127;address++) if(present(address)) {
      Serial.print(F("Found 0x"));
      if(address<16) Serial.print('0');
      Serial.println(address,HEX); found++;
    }
  } else Serial.println(F("BUS HELD LOW: check power/wiring."));
  Serial.print(F("Devices detected: ")); Serial.println(found);
  lcdOK=present(0x27); smallOK=present(0x3C); largeOK=present(0x3D);
  if(lcdOK) {
    lcdOK=lcdBegin();
    if(lcdOK) {lcdLine(0,"O.R.B.I.Tstartup"); lcdLine(1,"Starting in 5s");}
  }
  smallOLED.setI2CAddress(0x78); smallOLED.setBusClock(50000);
  largeOLED.setI2CAddress(0x7A); largeOLED.setBusClock(50000);
  if(smallOK) smallOLED.begin();
  if(largeOK) largeOLED.begin();
  // Restore SoftwareWire's bus configuration after display initialization.
  bus.begin(); bus.setClock(50000); bus.setTimeout(5);
  ahtOK=present(0x38) && ahtBegin();
  inaOK=present(0x40) && writeINARegister(0,0x399F)
                      && writeINARegister(5,4096);
  if(!lcdOK) Serial.println(F("LCD missing/failed at 0x27"));
  if(!smallOK) Serial.println(F("Small OLED missing at 0x3C"));
  if(!largeOK) Serial.println(F("Large OLED missing at 0x3D"));
  if(!ahtOK) Serial.println(F("AHT30 init failed at 0x38"));
  if(!inaOK) Serial.println(F("INA219 init failed at 0x40"));
  beginBMP();
  if(!muted) startSound(startupTune,false);
  Serial.print(F("Startup tune: "));Serial.println(startupTune+1);
  lastClimate=millis()-2000UL; lastPower=millis()-250UL;
  startupAnimating=true;
  startupAnimationStarted=millis();
  lastAnimationFrame=millis()-80UL;
}
void loop() {
  serviceControls(); serviceClimate(); serviceControls(); servicePower();
  serviceControls();
  // Keep the AHT30 timing fix: no display transfer while a reading is pending.
  if(climatePending) return;
  serviceBMP();serviceControls();
  if(startupAnimating) {
    unsigned long elapsed=millis()-startupAnimationStarted;
    if(elapsed<5000UL) {
      drawSecondaryStartup(elapsed);
      if(largeOK && millis()-lastAnimationFrame>=80UL) {
        lastAnimationFrame=millis();
        renderStartupLogo(min(elapsed,LOGO_TOTAL_MS-1));
        sendOLED(largeOLED);
      }
      return;
    }
    startupAnimating=false;
    lastDisplay=millis()-1000UL;
  }
  if(millis()-lastDisplay>=1000UL) {lastDisplay=millis(); drawDisplays();}
  // Keep animation independent of the slower LCD/environment refresh.
  // The software-I2C transfer rate determines the achievable frame rate.
  if(largeOK && millis()-lastLargeFrame>=120UL) {
    lastLargeFrame=millis();renderLargeUI();sendOLED(largeOLED);
  }
}
